/ {
    esb_split {
        compatible = "zmk,esb-split";
        base-addr-0 = <0xB7 0x63 0xA9 0xD5>;
        base-addr-1 = <0xC9 0x57 0x8D 0xAB>;
        addr-prefix = <0xA7 0xD3 0x69 0xB5 0xC7 0x9B 0xE3 0x5D>;
    };
};
