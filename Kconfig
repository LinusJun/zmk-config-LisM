## Kconfig
```kconfig
config LISM_PROSPECTOR_LOCK_INDICATORS
    bool "Compact OPERATOR modifiers with Caps/Num Lock indicators"
    default y
    depends on PROSPECTOR_STATUS_SCREEN_OPERATOR
    depends on ZMK_HID_INDICATORS
    help
      Extends the OPERATOR modifier row with CAP and NUM host LED indicators,
      using one compact font, baseline, and spacing scheme for all six labels.

config LISM_BLE_INPUT_BRIDGE
    bool "Standard BLE inputs with ESB-first admission control"
    depends on ZMK_SPLIT_ROLE_CENTRAL && ZMK_BLE
    select BT_CENTRAL
    select BT_OBSERVER
    select BT_GATT_CLIENT
    default y if SHIELD_LISM_DONGLE
config LISM_INPUT_LEGACY_COMPAT
    bool
    default y if LISM_BLE_INPUT_BRIDGE
config LISM_INPUT_AUTO_PAIR
    bool
    default y if LISM_INPUT_LEGACY_COMPAT

config LISM_KB_ROUTE
    bool "Right-hand whole-keyboard BLE/dongle output routing"
    default y
config LISM_KB_HUB
    bool "Right-hand ESB hub with five independent BLE computer slots"
    default y if SHIELD_LISM_R
    depends on ZMK_SPLIT_ROLE_CENTRAL && ZMK_BLE

config LISM_XIAO147_TOUCH
    bool "XIAO 1.47 fixed landscape touch display"
    depends on SHIELD_XIAO_PLUS_147_TOUCH && INPUT && I2C

config LISM_DONGLE_STATION
    int "Fixed dongle station (A=0, B=1)"
    range 0 1
    default 0

config LISM_XIAO147_AUTO_TOUCH
    bool "Existing guarded automatic AXS touch classifier"
    depends on LISM_XIAO147_TOUCH
    default y

config LISM_KEYBOARD_SET
    int "LisM keyboard set (Set1=0, Set2=1)"
    range 0 1
    default 0
```

## boards/shields/joystick_usb_test/Kconfig.defconfig
```kconfig
if SHIELD_JOYSTICK_USB_TEST

config ZMK_KEYBOARD_NAME
    default "JP19 USB Test"

config ZMK_USB
    default y

config LISM_RESISTIVE_JOYSTICK
    default y

endif
```

## boards/shields/joystick_usb_test/Kconfig.shield
```kconfig
config SHIELD_JOYSTICK_USB_TEST
    def_bool $(shields_list_contains,joystick_usb_test)
```

## boards/shields/lism/Kconfig.defconfig
```kconfig
if SHIELD_LISM_L || SHIELD_LISM_R || SHIELD_LISM_DONGLE || SHIELD_LISM_JOYSTICK

config ZMK_KEYBOARD_NAME
    default "LisM"

config ZMK_SPLIT
    default y

endif

if SHIELD_LISM_L || SHIELD_LISM_R || SHIELD_LISM_DONGLE

config ZMK_POINTING
    default y

config ZMK_MOUSE
    default y

config INPUT
    default y

endif

if SHIELD_LISM_L || SHIELD_LISM_R

config PAW3222
    default y

config SPI
    default y

endif

if SHIELD_LISM_JOYSTICK

config ADC
    default y

config LISM_RESISTIVE_JOYSTICK
    default y

endif

if SHIELD_LISM_DONGLE

config ZMK_SPLIT_ROLE_CENTRAL
    default y

config ZMK_USB
    default y

config ZMK_SPLIT_BLE_CENTRAL_PERIPHERALS
    default 3

# Three split peripherals plus the five normal host profiles.
config BT_MAX_CONN
    default 8

config BT_MAX_PAIRED
    default 8

endif
```

## boards/shields/xiao_plus_147_touch/Kconfig.shield
```kconfig
config SHIELD_XIAO_PLUS_147_TOUCH
    def_bool $(shields_list_contains,xiao_plus_147_touch)
```

## config/west.yml
```yaml
manifest:
  remotes:
    - name: zmkfirmware
      url-base: https://github.com/zmkfirmware
    - name: sekigon-gonnoc
      url-base: https://github.com/sekigon-gonnoc
    - name: caksoylar
      url-base: https://github.com/caksoylar
    - name: 4mplelab
      url-base: https://github.com/4mplelab
    - name: carrefinho
      url-base: https://github.com/carrefinho
    - name: nrfconnect
      url-base: https://github.com/nrfconnect
    - name: badjeff
      url-base: https://github.com/badjeff
  projects:
    - name: zmk
      remote: zmkfirmware
      # ZMK main @ 2026-09-15 (Zephyr 4.1; required by the Prospector screen branch).
      revision: 9ebbeff0a8b69a42f14aec022cdf16c7a107b9e0
      import: app/west.yml
    - name: zmk-driver-paw3222
      remote: sekigon-gonnoc
      revision: df652881be2520bde4f64ab6ca35e4c5708f4f9b
    - name: zmk-rgbled-widget
      remote: caksoylar
      # v0.3 is for ZMK v0.3; main tracks current ZMK/Zephyr 4.x.
      revision: e6b467792a1dabef8cfa5c9fd26bfefc9c16662b
    - name: zmk-feature-charge-indicator
      remote: 4mplelab
      revision: f0d311ed7804cda0e5837ef902f0419aeace4a88
    - name: prospector-zmk-module
      remote: carrefinho
      revision: ed98221f3b52b7066dbb10ba3af8a29150b93a5a
    - name: zmk-input-processor-report-rate-limit
      remote: badjeff
      revision: b056cb135525933743e2627150fb390f9d4b2461
    - name: zmk-input-processor-xyz
      remote: badjeff
      revision: edb44b7261796a11b3aaecc0f75f1da615789b90
    - name: nrf
      repo-path: sdk-nrf
      remote: badjeff
      revision: 9b3d2623fdcd9c0fd0284f860beea924568c9826
    - name: nrfxlib
      repo-path: sdk-nrfxlib
      remote: nrfconnect
      revision: dfadf17305d8f000eda9aa74a5b9ff1c5647a23e
  self:
    path: config
```

## dts/bindings/behaviors/lism,behavior-kb-route.yaml
```yaml
description: Whole LisM keyboard output route and its independent five BLE host profiles
compatible: "lism,behavior-kb-route"
include: one_param.yaml
```

## dts/bindings/behaviors/lism,behavior-screen-next.yaml
```yaml
description: Switch receiver status and BLE input pages
compatible: "lism,behavior-screen-next"
include: zero_param.yaml
```

## dts/bindings/input/lism,axs5106l-touchpad.yaml
```yaml
description: AXS5106L capacitive panel used as a relative ZMK mouse touchpad
compatible: "lism,axs5106l-touchpad"
include: i2c-device.yaml
```

## dts/bindings/kscan/linus,resistive-joystick.yaml
```yaml
description: Resistive joystick with X/Y analog axes and optional push input

compatible: "linus,resistive-joystick"

include: kscan.yaml

properties:
  io-channels:
    type: phandle-array
    required: true
    description: ADC channels in X, Y order

  press-gpios:
    type: phandle-array
    description: Optional active-low push switch; absent on four-wire Circle Pad

  poll-period-ms:
    type: int
    default: 10

  idle-poll-period-ms:
    type: int
    default: 0
    description: Slower sampling after continuous valid neutral; 0 disables this optimization

  idle-timeout-ms:
    type: int
    default: 0
    description: Required continuous valid neutral time before slower sampling

  sprint-full-radius:
    type: int
    default: 0
    description: Estimated radial full travel in ADC counts, independently tuned per device; 0 disables sprint

  sprint-enter-percent:
    type: int
    default: 50
    description: Press virtual Left Shift above this percentage of the estimated full radius, only with W

  sprint-exit-percent:
    type: int
    default: 45
    description: Release virtual Left Shift at or below this percentage, or whenever W is released

  activation-threshold:
    type: int
    default: 550
    description: ADC counts away from center (radial distance in eight-sector mode) to press

  release-threshold:
    type: int
    default: 400
    description: ADC counts away from center (radial distance in eight-sector mode) to release

  calibration-samples:
    type: int
    default: 32
    description: Center samples collected while the stick is untouched at startup

  center-min:
    type: int
    default: 600
    description: Minimum accepted neutral ADC count

  center-max:
    type: int
    default: 3400
    description: Maximum accepted neutral ADC count

  calibration-max-spread:
    type: int
    default: 100
    description: Maximum ADC spread during startup center sampling

  sample-min:
    type: int
    default: 80
    description: Lower ADC rail guard after calibration

  sample-max:
    type: int
    default: 4000
    description: Upper ADC rail guard after calibration

  invert-x:
    type: boolean
    description: Reverse the X direction after sampling

  invert-y:
    type: boolean
    description: Reverse the Y direction after sampling

  swap-axes:
    type: boolean
    description: Exchange X and Y directions after sampling

  eight-sector:
    type: boolean
    description: Use radial dead zone and eight angular sectors

  strict-sector-boundaries:
    type: boolean
    description: Disable angular hysteresis for equal 45-degree sectors; radial hysteresis remains

  sector-hysteresis-degrees:
    type: int
    enum: [0, 1, 2, 3, 4, 5]
    description: Explicit 0 uses strict sectors; 1..5 holds the prior sector this many degrees. Absent preserves the legacy path. Conflicts with strict-sector-boundaries when nonzero.

  preserve-calibrated-center:
    type: boolean
    description: After initial calibration, release directions on ADC errors without recalibrating; reset to calibrate again
```

## dts/bindings/sensor/lism,lsm6ds3-air-mouse.yaml
```yaml
description: LSM6DS3 IMU on the Seeed XIAO 1.47-inch integrated display board
compatible: "lism,lsm6ds3-air-mouse"
include: i2c-device.yaml
```

## experimental/trimode/integration/west.yml
```yaml
# Opt-in Nordic coexistence dependencies. Keep default firmware manifest unchanged.
manifest:
  remotes:
  - name: zmkfirmware
    url-base: https://github.com/zmkfirmware
  - name: sekigon-gonnoc
    url-base: https://github.com/sekigon-gonnoc
  - name: caksoylar
    url-base: https://github.com/caksoylar
  - name: 4mplelab
    url-base: https://github.com/4mplelab
  - name: carrefinho
    url-base: https://github.com/carrefinho
  - name: badjeff
    url-base: https://github.com/badjeff
  - name: nrfconnect
    url-base: https://github.com/nrfconnect
  projects:
  - name: zmk
    remote: zmkfirmware
    revision: 9ebbeff0a8b69a42f14aec022cdf16c7a107b9e0
    import: app/west.yml
  - name: zephyr
    remote: zmkfirmware
    revision: 10ba6d0cb38bc3d258775d27982f707599320085
    clone-depth: 1
    import:
      name-blocklist:
      - ci-tools
      - hal_altera
      - hal_cypress
      - hal_infineon
      - hal_microchip
      - hal_nxp
      - hal_openisa
      - hal_xtensa
      - hal_st
      - hal_ti
      - loramac-node
      - mcuboot
      - mcumgr
      - net-tools
      - openthread
      - edtt
      - trusted-firmware-m
  - name: zmk-driver-paw3222
    remote: sekigon-gonnoc
    revision: df652881be2520bde4f64ab6ca35e4c5708f4f9b
  - name: zmk-rgbled-widget
    remote: caksoylar
    revision: e6b467792a1dabef8cfa5c9fd26bfefc9c16662b
  - name: zmk-feature-charge-indicator
    remote: 4mplelab
    revision: f0d311ed7804cda0e5837ef902f0419aeace4a88
  - name: prospector-zmk-module
    remote: carrefinho
    revision: ed98221f3b52b7066dbb10ba3af8a29150b93a5a
  - name: zmk-input-processor-report-rate-limit
    remote: badjeff
    revision: b056cb135525933743e2627150fb390f9d4b2461
  - name: zmk-input-processor-xyz
    remote: badjeff
    revision: edb44b7261796a11b3aaecc0f75f1da615789b90
  - name: nrf
    remote: badjeff
    revision: 9b3d2623fdcd9c0fd0284f860beea924568c9826
    repo-path: sdk-nrf
  - name: nrfxlib
    remote: nrfconnect
    revision: dfadf17305d8f000eda9aa74a5b9ff1c5647a23e
    repo-path: sdk-nrfxlib
  self:
    path: esb-manifest
```
